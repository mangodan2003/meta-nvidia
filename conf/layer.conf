## conf/layer.conf
```bitbake
# We might have a conf and classes directory, append to BBPATH
BBPATH .= ":${LAYERDIR}"

# We have a recipes directory, add to BBFILES
BBFILES += "${LAYERDIR}/recipes*/*/*.bb ${LAYERDIR}/recipes*/*/*.bbappend"

BBFILE_COLLECTIONS += "nvidia"
BBFILE_PATTERN_nvidia = "^${LAYERDIR}/"
BBFILE_PRIORITY_nvidia = "10"

LICENSE_PATH += " ${LAYERDIR}/custom-licenses"
LAYERSERIES_COMPAT_meta-subscriber-overrides = "dunfell gatesgarth hardknott"
```
